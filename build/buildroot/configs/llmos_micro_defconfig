## build/buildroot/configs/llmos_micro_defconfig
```kconfig
# LLM OS Micro — Buildroot defconfig
# Minimal x86_64 system: busybox + dropbear + Node.js (pre-built)
# Target: ~50MB compressed QCOW2 image

# Architecture
BR2_x86_64=y
BR2_x86_corei7=y

# Toolchain — musl for smallest binaries
BR2_TOOLCHAIN_BUILDROOT_MUSL=y
BR2_TOOLCHAIN_BUILDROOT_CXX=y

# Init system — busybox init (simplest, smallest)
BR2_INIT_BUSYBOX=y

# System configuration
BR2_SYSTEM_DHCP="eth0"
BR2_TARGET_GENERIC_HOSTNAME="llmos"
BR2_TARGET_GENERIC_ISSUE="LLM OS Micro"
BR2_TARGET_GENERIC_ROOT_PASSWD="llmos"
BR2_TARGET_GENERIC_GETTY_PORT="ttyS0"
BR2_TARGET_GENERIC_GETTY_BAUDRATE_115200=y
BR2_SYSTEM_BIN_SH_BUSYBOX=y

# Linux kernel
BR2_LINUX_KERNEL=y
BR2_LINUX_KERNEL_CUSTOM_VERSION=y
BR2_LINUX_KERNEL_CUSTOM_VERSION_VALUE="6.12.10"
BR2_LINUX_KERNEL_USE_CUSTOM_CONFIG=y
BR2_LINUX_KERNEL_CUSTOM_CONFIG_FILE="$(TOPDIR)/../configs/linux_micro.config"
BR2_LINUX_KERNEL_BZIMAGE=y

# Bootloader — syslinux/extlinux (MBR)
BR2_TARGET_SYSLINUX=y
BR2_TARGET_SYSLINUX_MBR=y

# Packages
BR2_PACKAGE_BUSYBOX=y
BR2_PACKAGE_BUSYBOX_SHOW_OTHERS=y

# SSH server — dropbear (tiny, ~200KB vs OpenSSH ~5MB)
BR2_PACKAGE_DROPBEAR=y
BR2_PACKAGE_DROPBEAR_DISABLE_REVERSEDNS=y
BR2_PACKAGE_DROPBEAR_SMALL=y

# TLS/crypto for HTTPS to LLM APIs
BR2_PACKAGE_CA_CERTIFICATES=y
BR2_PACKAGE_OPENSSL=y

# Compression
BR2_PACKAGE_ZLIB=y

# Filesystem output — ext4
BR2_TARGET_ROOTFS_EXT2=y
BR2_TARGET_ROOTFS_EXT2_4=y
BR2_TARGET_ROOTFS_EXT2_SIZE="224M"
BR2_TARGET_ROOTFS_EXT2_LABEL="LLMOS"

# Don't build other rootfs formats
# BR2_TARGET_ROOTFS_CPIO is not set
# BR2_TARGET_ROOTFS_TAR is not set

# Overlay and hooks
BR2_ROOTFS_OVERLAY="$(TOPDIR)/../board/llmos/overlay"
BR2_ROOTFS_POST_BUILD_SCRIPT="$(TOPDIR)/../board/llmos/post-build.sh"
BR2_ROOTFS_POST_IMAGE_SCRIPT="$(TOPDIR)/../board/llmos/post-image.sh"

# Host tools for image generation
BR2_PACKAGE_HOST_GENIMAGE=y
BR2_PACKAGE_HOST_DOSFSTOOLS=y
BR2_PACKAGE_HOST_MTOOLS=y

# Disable unnecessary defaults
# BR2_PACKAGE_IFUPDOWN_SCRIPTS is not set
# BR2_TARGET_ROOTFS_TAR is not set
```
